#include <behaviors.dtsi>
#include <behaviors/num_word.dtsi> // Requires auto-layer module.
#include <dt-bindings/zmk/keys.h>
#ifdef CONFIG_WIRELESS
  #include <dt-bindings/zmk/bt.h>
  #include <dt-bindings/zmk/outputs.h>
  #define _BT_SEL_KEYS_                                                        \
      &bt BT_SEL 0 &bt BT_SEL 1 &bt BT_SEL 2 
#else
  #define _BT_SEL_KEYS_ &trans &trans &trans &trans &trans
#endif

#include "zmk-helpers/helper.h"
#include "zmk-helpers/unicode-chars/greek.dtsi"
#include "zmk-helpers/unicode-chars/german.dtsi"

#define DEF 0
#define NAV 1
#define FN 2
#define NUM 3
#define SYS 4
#define MOUSE 5
#define UC 6
#define SYM 7

#define XXX &none
#define ___ &trans

/* Global defaults */

#define QUICK_TAP_MS 175

&sk {
  release-after-ms = <900>;
  quick-release;
};

&sl { // Allow sticky mods to chord across sticky layers.
  ignore-modifiers;
};

&lt {
  flavor = "balanced";
  tapping-term-ms = <200>;
  quick-tap-ms = <QUICK_TAP_MS>;
};

/* Homerow mods */

#define KEYS_L LT0 LT1 LT2 LT3 LT4 LM0 LM1 LM2 LM3 LM4 LB0 LB1 LB2 LB3 LB4
#define KEYS_R RT0 RT1 RT2 RT3 RT4 RM0 RM1 RM2 RM3 RM4 RB0 RB1 RB2 RB3 RB4
#ifndef LH2
  #define THUMBS LH1 LH0 RH0 RH1         // Thumbs on 34 keys.
#else
  #define THUMBS LH2 LH1 LH0 RH0 RH1 RH2 // Thumbs on 36+ keys.
#endif

#define MAKE_HRM(NAME, HOLD, TAP, TRIGGER_POS)                                 \
  ZMK_HOLD_TAP(NAME, bindings = <HOLD>, <TAP>; flavor = "balanced";            \
               tapping-term-ms = <280>; quick-tap-ms = <QUICK_TAP_MS>;         \
               require-prior-idle-ms = <150>; hold-trigger-on-release;         \
               hold-trigger-key-positions = <TRIGGER_POS>;)

MAKE_HRM(hml, &kp, &kp, KEYS_R THUMBS) // Left-hand HRMs.
MAKE_HRM(hmr, &kp, &kp, KEYS_L THUMBS) // Right-hand HRMs.

// Additional HRM variants for special behaviors
MAKE_HRM(hml_repeat, &kp, &key_repeat, KEYS_R THUMBS)  // HRM with key repeat
MAKE_HRM(hmr_lpar_lt, &kp, &lpar_lt, KEYS_R THUMBS)    // HRM with left paren/less-than
MAKE_HRM(hmr_rpar_gt, &kp, &rpar_gt, KEYS_R THUMBS)    // HRM with right paren/greater-than
MAKE_HRM(hml_copy_all, &kp, &copy_all_td, KEYS_R THUMBS) // HRM with copy all

// Hack: Make HRM combos tap-only (cf, ZMK issue #544).
#define ZMK_COMBO_8(NAME, TAP, POS, LAYERS, COMBO_MS, IDLE_MS, HOLD, SIDE)     \
  MAKE_HRM(hm_combo_##NAME, &kp, TAP, SIDE THUMBS)                             \
  ZMK_COMBO_6(NAME, &hm_combo_##NAME HOLD 0, POS, LAYERS, COMBO_MS, IDLE_MS)

/* Combos, leader key sequences, mouse emulation */

#include "combos.dtsi" // Must be sourced after HRM-combo hack.
#include "leader.dtsi"
#include "mouse.dtsi"

/* Nav cluster */

// Trigger tap-action on all interrupts.
#define MT_CORE                                                                \
  flavor = "tap-preferred";                                                    \
  tapping-term-ms = <220>;                                                     \
  quick-tap-ms = <220>;                                                        \
  hold-trigger-key-positions = <0>;

&mt { MT_CORE };

ZMK_HOLD_TAP(mt_home, bindings = <&masked_home>, <&kp>; MT_CORE)
ZMK_HOLD_TAP(mt_end, bindings = <&masked_end>, <&kp>; MT_CORE)

#define NAV_LEFT  &mt_home 0   LEFT  // Tap: left  | Long-tap: start of line.
#define NAV_RIGHT &mt_end 0    RIGHT // Tap: right | Long-tap: end   of line.
#define NAV_UP    &mt LC(HOME) UP    // Tap: up    | Long-tap: start of doc.
#define NAV_DOWN  &mt LC(END)  DOWN  // Tap: down  | Long-tap: end   of doc.
#define NAV_BSPC  &mt LC(BSPC) BSPC  // Tap: bspc  | Long-tap: delete word bwd.
#define NAV_DEL   &mt LC(DEL)  DEL   // Tap: del   | Long-tap: delete word fwd.

// Mask CTRL on left/right hold to avoid accidental jumps to start/end of doc.
#define MASK_MODS(NAME, MODS, BINDING)                                         \
  ZMK_MOD_MORPH(NAME, bindings = <BINDING>, <BINDING>; mods = <MODS>;)

MASK_MODS(masked_home, (MOD_LCTL), &kp HOME)
MASK_MODS(masked_end,  (MOD_LCTL), &kp END)

/* Magic-shift & auto-layers */

// Tap: repeat after alpha, else sticky-shift |
// Shift + tap/ double-tap: caps-word | Hold: shift.
#define MAGIC_SHIFT &magic_shift LSHFT 0
ZMK_HOLD_TAP(magic_shift, bindings = <&kp>, <&magic_shift_tap>;
             flavor = "balanced"; tapping-term-ms = <200>;
             quick-tap-ms = <QUICK_TAP_MS>;)
ZMK_MOD_MORPH(magic_shift_tap, bindings = <&shift_repeat>, <&caps_word>;
              mods = <(MOD_LSFT)>;)
ZMK_ADAPTIVE_KEY(
    shift_repeat, bindings = <&sk LSHFT>;
    repeat {
      trigger-keys = <A B C D E F G H I J K L M N O P Q R S T U V W X Y Z>;
      bindings = <&key_repeat>;
      max-prior-idle-ms = <1200>;
      strict-modifiers;
    };)
&caps_word { // Mods deactivate caps-word, requires PR #1451. [TODO: rebase]
  /delete-property/ ignore-modifiers;
};

// Tap: num-word | double-tap: sticky num-layer | Hold: num-layer.
#define SMART_NUM &smart_num NUM 0
ZMK_HOLD_TAP(smart_num, bindings = <&mo>, <&num_dance>; flavor = "balanced";
             tapping-term-ms = <200>; quick-tap-ms = <QUICK_TAP_MS>;)
ZMK_TAP_DANCE(num_dance, bindings = <&num_word NUM>, <&sl NUM>;
              tapping-term-ms = <200>;)

// Smart-mouse, requires tri-state module.
ZMK_TRI_STATE(
    smart_mouse, bindings = <&tog MOUSE>, <&none>, <&tog MOUSE>;
    ignored-key-positions =
        <LT1 LT2 LH0 LH1 RT1 RT2 RT3 RM0 RM1 RM2 RM3 RM4 RB1 RB2 RB3 RH0 RH1>;
    ignored-layers = <MOUSE NAV FN>;)

/* Custom behaviors */

// Alt+Tab swapper, requires tri-state module.
ZMK_TRI_STATE(swapper, bindings = <&kt LALT>, <&kp TAB>, <&kt LALT>;
              ignored-key-positions = <LT2 RT2 RM1 RM2 RM3>;)

// Define mod-morph with a *single* mod trigger for less repetition.
#define SIMPLE_MORPH(NAME, MOD, BINDING1, BINDING2)                            \
  ZMK_MOD_MORPH(NAME, mods = <(MOD_L##MOD | MOD_R##MOD)>;                      \
                bindings = <BINDING1>, <BINDING2>;)

// Tap: comma | Shift + tap: semicolon | Ctrl + shift + tap: <.
SIMPLE_MORPH(comma_morph, SFT, &kp COMMA, &comma_inner_morph)
SIMPLE_MORPH(comma_inner_morph, CTL, &kp SEMICOLON, &kp LESS_THAN)

// Tap: dot | Shift + tap: colon | Ctrl + shift + tap: >.
SIMPLE_MORPH(dot_morph, SFT, &kp DOT, &dot_inner_morph)
SIMPLE_MORPH(dot_inner_morph, CTL, &kp COLON, &kp GREATER_THAN)

// Tap: qmark | Shift + tap: excl.
SIMPLE_MORPH(qexcl, SFT, &kp QMARK, &kp EXCL)

// Tap: left/right parenthesis | Shft + tap: less-than/greater-than.
SIMPLE_MORPH(lpar_lt, SFT, &kp LPAR, &kp LT)
SIMPLE_MORPH(rpar_gt, SFT, &kp RPAR, &kp GT)

// Tap: space | Shift + tap: dot -> space -> sticky shift | Hold: nav layer.
ZMK_HOLD_TAP(lt_spc, bindings = <&mo>, <&spc_morph>; flavor = "balanced";
             tapping-term-ms = <200>; quick-tap-ms = <QUICK_TAP_MS>;)
SIMPLE_MORPH(spc_morph, SFT, &kp SPACE, &dot_spc)
ZMK_MACRO(dot_spc, bindings = <&kp DOT &kp SPACE &sk LSHFT>; wait-ms = <0>;
          tap-ms = <5>;)

// Tap: backspace | Lshft + tap: delete | Rshft + tap: shift-delete.
ZMK_MOD_MORPH(bs_del, bindings = <&kp BSPC>, <&kp DEL>;
              mods = <(MOD_LSFT|MOD_RSFT)>; keep-mods = <MOD_RSFT>;)

// Tap: copy | double-tap: cut.
ZMK_TAP_DANCE(copy_cut, bindings = <&kp LC(INS)>, <&kp LC(X)>;
              tapping-term-ms = <200>;)

// Copy all (Cmd+A, Cmd+C)
ZMK_MACRO(copy_all, bindings = <&kp LG(A) &kp LG(C)>; wait-ms = <5>; tap-ms = <3>;)

ZMK_TAP_DANCE(copy_all_td, bindings = <&kp LG(C)>, <&copy_all>;
              tapping-term-ms = <200>;)

// Paste all (Cmd+A, Cmd+V) 
ZMK_MACRO(paste_all, bindings = <&kp LG(A) &kp LG(V)>; wait-ms = <5>; tap-ms = <3>;)

ZMK_TAP_DANCE(paste_all_td, bindings = <&kp LG(V)>, <&paste_all>;
              tapping-term-ms = <200>;)

// Navigation macros - 5x down/up
ZMK_MACRO(nav_5_down, bindings = <&kp DOWN &kp DOWN &kp DOWN &kp DOWN &kp DOWN>; 
          wait-ms = <5>; tap-ms = <3>;)

ZMK_MACRO(nav_5_up, bindings = <&kp UP &kp UP &kp UP &kp UP &kp UP>; 
          wait-ms = <5>; tap-ms = <3>;)

// Quick nav with Alt modifier
SIMPLE_MORPH(qnav_down, ALT, &kp DOWN, &nav_5_down)
SIMPLE_MORPH(qnav_up, ALT, &kp UP, &nav_5_up)

// Key toggle for Alt+GUI combo
ZMK_MACRO(kt_la_gui, bindings = <&kt LALT &kt LGUI>; wait-ms = <0>; tap-ms = <5>;)

// Smart shift: tap = sticky shift, shift+tap = caps word
ZMK_MOD_MORPH(smart_shft, bindings = <&sk LSHFT>, <&caps_word>; mods = <(MOD_LSFT)>;)

// Smart backspace: tap = bspc, lshift+tap = del, rshift+tap = shift-del  
// (Note: bs_del is already defined above in the original behaviors section)

// Num word dance for smart num behavior
ZMK_TAP_DANCE(num_dance, bindings = <&sl NUM>, <&sl NUM>; tapping-term-ms = <200>;)

// Smart num: tap = num-word, double-tap = sticky num layer, hold = num layer
// (Note: smart_num is already defined above in the original behaviors section)

// Window swapper: Alt+Tab behavior
ZMK_TRI_STATE(window_swapper, bindings = <&kt LALT>, <&kp TAB>, <&kt LALT>;
              ignored-key-positions = <LT2>;)

// App tab swapper: Cmd+Tab behavior  
ZMK_TRI_STATE(tab_swapper, bindings = <&kt_la_gui>, <&kp RIGHT>, <&kt_la_gui>;
              ignored-key-positions = <LB2 LB3 LB4>;)

// Sticky layer + sticky shift (workaround for issue #1421)
ZMK_STICKY_KEY(sls, release-after-ms = <1000>; bindings = <&uc_shift>; ignore-modifiers;)

ZMK_MACRO(uc_shift, bindings = <&macro_press &mo UC &kp LSHFT>,
                               <&macro_pause_for_release>,
                               <&macro_release &mo UC &kp LSHFT>;
          wait-ms = <0>; tap-ms = <1>;)

// Navigation close/recent tab macros  
ZMK_MACRO(nav_close, bindings = <&kt_la_gui>, <&kp LC(W)>, <&kt_la_gui>;
          wait-ms = <20>; tap-ms = <5>;)

ZMK_MACRO(nav_recent_tab, bindings = <&kt_la_gui>, <&kp LC(LS(T))>, <&kt_la_gui>;
          wait-ms = <20>; tap-ms = <5>;)

// Sticky shift + leader.
ZMK_MACRO(leader_sft, bindings = <&sk LSHFT &leader>;)

// Additional useful macros
ZMK_MACRO(screenshot, bindings = <&kp LG(LS(N4))>; wait-ms = <0>; tap-ms = <5>;)
ZMK_MACRO(spotlight, bindings = <&kp LG(SPACE)>; wait-ms = <0>; tap-ms = <5>;)

// Emoji picker (for macOS)
ZMK_MACRO(emoji, bindings = <&kp LG(LC(SPACE))>; wait-ms = <0>; tap-ms = <5>;)

// Task manager equivalents
ZMK_MACRO(task_mgr, bindings = <&kp LG(LALT)>; wait-ms = <0>; tap-ms = <5>;)

// Close window
ZMK_MACRO(close_win, bindings = <&kp LG(W)>; wait-ms = <0>; tap-ms = <5>;)

// Minimize window
ZMK_MACRO(minimize, bindings = <&kp LG(M)>; wait-ms = <0>; tap-ms = <5>;)

// Misc aliases. [TODO: clean up]
#define CANCEL    &kp K_CANCEL            // Cancel caps-word & auto-layers.
#define DSK_PREV  &hmr RSHFT LG(LC(LEFT)) // Previous desktop.
#define DSK_NEXT  &hmr LALT LG(LC(RIGHT)) // Next     desktop.
#define PIN_WIN   &kp LG(LC(LS(Q)))       // Pin window across desktops.
#define PIN_APP   &kp LG(LC(LS(A)))       // Pin application across desktops.
#define DSK_MGR   &kp LA(GRAVE)           // Desktop manager.
#define VOL_DOWN  &hmr LCTRL C_VOL_DN
#define SMART_NUM &smart_num NUM 0

// Navigation and browser shortcuts
#define BACK      &kp LG(LBKT)            // Back
#define FORWARD   &kp LG(RBKT)            // Forward

// Special macros for system shortcuts
#define WHISPER   &kp LC(LA(N1))
#define M_1       &kp LG(LC(LA(N2)))
#define M_2       &kp LG(LC(LA(N3)))
#define M_3       &kp LG(LC(LA(N4)))
#define M_4       &kp LG(LC(LA(N5)))
#define M_5       &kp LG(LC(LA(N6)))
#define M_6       &kp LG(LC(LA(N7)))
#define M_7       &kp LG(LC(LA(N8)))

// Additional shortcuts
#define SCREENSHOT &screenshot
#define SPOTLIGHT  &spotlight
#define EMOJI      &emoji
#define TASK_MGR   &task_mgr
#define CLOSE_WIN  &close_win
#define MINIMIZE   &minimize

// Quick access to commonly used symbols
#define LBRACKET  &kp LBKT
#define RBRACKET  &kp RBKT
#define LPAREN    &kp LPAR
#define RPAREN    &kp RPAR
#define LBRACE    &kp LBRC
#define RBRACE    &kp RBRC

// Text manipulation
#define SELECT_ALL &kp LG(A)
#define FIND       &kp LG(F)
#define REPLACE    &kp LG(LA(F))

/* Keymap */

// ZMK_CONDITIONAL_LAYER(sys, FN NUM, SYS) // FN + NUM --> SYS. 

#ifndef ZMK_BASE_LAYER
  #define ZMK_BASE_LAYER(name, LT, RT, LM, RM, LB, RB, LH, RH)                 \
      ZMK_LAYER(name, LT RT LM RM LB RB LH RH)
#endif

# define SFT_RET &kp LS(RETURN)
# define SLEEP &kp RC(RG(Q))
# define MUTE &kp (LG(D))
# define TOG_NAV &tog NAV
# define SAVE_SONG &kp LG(LS(LA(R)))


ZMK_LAYER(base,
//╭──────╮ ╭─────────────┬─────────────┬─────────────┬─────────────┬─────────────╮  ╭─────────────┬─────────────┬─────────────┬─────────────┬─────────────╮ ╭──────╮
  &kp TAB      &kp Q         &kp W         &kp F         &kp P         &kp G            &kp J         &kp L         &kp U         &kp Y         &kp COLON           MUTE
//├──────┤ ├─────────────┼─────────────┼─────────────┼─────────────┼─────────────┤  ├─────────────┼─────────────┼─────────────┼─────────────┼─────────────┤ ├──────┤
   SFT_RET   &hml LGUI A  &hml LALT R   &hml LCTRL S   &hml LSHFT T  &kp D            &kp H         &hmr RSHFT N  &hmr RCTRL E   &hmr RALT I   &hmr RGUI O  &kp BSPC
//├──────┤ ├─────────────┼─────────────┼─────────────┼─────────────┼─────────────┤  ├─────────────┼─────────────┼─────────────┼─────────────┼─────────────┤ ├──────┤
  WHISPER    &kp Z         &kp X         &kp C         &kp V         &kp B            &kp K         &kp M         &comma_morph  &dot_morph    &kp FSLH       SAVE_SONG
//╰──────╯ ╰─────────────┼─────────────┴─────────────┼─────────────┼─────────────┤  ├─────────────┼─────────────┼─────────────┴───────────────────────────╯ ╰──────╯
                                         &lt FN ESC    &lt_spc NAV 0 &kp SPACE     &kp RETURN &lt NUM BSPC &smart_shft
//                                     ╰─────────────┴─────────────┴─────────────╯  ╰─────────────┴─────────────┴─────────────╯
)

ZMK_LAYER(nav,
//╭──────╮ ╭─────────────┬─────────────┬─────────────┬─────────────┬─────────────╮  ╭─────────────┬─────────────┬─────────────┬─────────────┬─────────────╮ ╭──────╮
     &kp TAB    &kp N1        &kp N2        &kp N3        &kp N4        &kp N5            &kp N6         &kp N7       &kp N8    &kp N9       &kp N0          XXX
//├──────┤ ├─────────────┼─────────────┼─────────────┼─────────────┼─────────────┤  ├─────────────┼─────────────┼─────────────┼─────────────┼─────────────┤ ├──────┤
    XXX      &kp LESS_THAN &kp GREATER_THAN &kp MINUS &kp PLUS &kp COMMA              &kp DOT      &kp LEFT    &kp DOWN      &kp UP  &kp RIGHT     &kp COLON
//├──────┤ ├─────────────┼─────────────┼─────────────┼─────────────┼─────────────┤  ├─────────────┼─────────────┼─────────────┼─────────────┼─────────────┤ ├──────┤
    XXX      BACK        FORWARD         &kp LEFT      &tab_swapper  ___              ___           &kp TAB       &kp PG_DN     &kp PG_UP     ___             XXX
//╰──────╯ ╰─────────────┼─────────────┴─────────────┼─────────────┼─────────────┤  ├─────────────┼─────────────┼─────────────┴───────────────────────────╯ ╰──────╯
                                         ___           ___           ___              &kp RETURN    NAV_BSPC      XXX
//                                     ╰─────────────┴─────────────┴─────────────╯  ╰─────────────┴─────────────┴─────────────╯
)

ZMK_LAYER(fn,
//╭──────╮ ╭─────────────┬─────────────┬─────────────┬─────────────┬─────────────╮  ╭─────────────┬─────────────┬─────────────┬─────────────┬─────────────╮ ╭──────╮
    XXX      &kp F12       &kp F7        &kp F8        &kp F9        ___              &bt BT_SEL 0 &bt BT_SEL 1 &bt BT_SEL 2 &bt BT_SEL 3 &bt BT_CLR            XXX
//├──────┤ ├─────────────┼─────────────┼─────────────┼─────────────┼─────────────┤  ├─────────────┼─────────────┼─────────────┼─────────────┼─────────────┤ ├──────┤
    XXX      &hml LCTRL F11 &hml LALT F4  &hml LGUI F5 &hml LSHFT F6 ___              ___           &kp C_PREV    &kp C_VOL_DN  &kp C_VOL_UP  &kp C_NEXT      XXX
//├──────┤ ├─────────────┼─────────────┼─────────────┼─────────────┼─────────────┤  ├─────────────┼─────────────┼─────────────┼─────────────┼─────────────┤ ├──────┤
    XXX      &kp F10       &kp F1        &kp F2        &kp F3        ___              ___           ___           ___           ___           ___             XXX
//╰──────╯ ╰─────────────┼─────────────┴─────────────┼─────────────┼─────────────┤  ├─────────────┼─────────────┼─────────────┴───────────────────────────╯ ╰──────╯
                                         ___           ___           ___              &kp C_MUTE    &kp C_PP      XXX
//                                     ╰─────────────┴─────────────┴─────────────╯  ╰─────────────┴─────────────┴─────────────╯
)

ZMK_LAYER(num,
//╭──────╮ ╭─────────────┬─────────────┬─────────────┬─────────────┬─────────────╮  ╭─────────────┬─────────────┬─────────────┬─────────────┬─────────────╮ ╭──────╮
   &kp  TAB  &kp EXCL       &kp AT       &kp HASH      &kp DLLR       &kp PRCNT          &kp CARET    &kp AMPS      &kp ASTRK    &kp UNDER     &kp BSLH     &kp BSPC
//├──────┤ ├─────────────┼─────────────┼─────────────┼─────────────┼─────────────┤  ├─────────────┼─────────────┼─────────────┼─────────────┼─────────────┤ ├──────┤
   &kp LCTRL &kp SEMI     &kp EQUAL   &kp LPAR      &kp RPAR      &kp LBKT                 &kp RBKT     &kp LBRC      &kp RBRC    &kp DOUBLE_QUOTES &kp SINGLE_QUOTE  &kp GRAVE
//├──────┤ ├─────────────┼─────────────┼─────────────┼─────────────┼─────────────┤  ├─────────────┼─────────────┼─────────────┼─────────────┼─────────────┤ ├──────┤
      &kp LSHFT &kp COLON      CANCEL           &kp MINUS     &kp PLUS       NAV_DEL             &kp MINUS     &kp PLUS      &kp LBRC      &kp RBRC      &kp PIPE     &kp TILDE
//╰──────╯ ╰─────────────┼─────────────┴─────────────┼─────────────┼─────────────┤  ├─────────────┼─────────────┼─────────────┴───────────────────────────╯ ╰──────╯
                                         &kp UNDER     ___           ___              ___           ___           XXX
//                                     ╰─────────────┴─────────────┴─────────────╯  ╰─────────────┴─────────────┴─────────────╯
)

ZMK_LAYER(sys,
//╭──────╮ ╭─────────────┬─────────────┬─────────────┬─────────────┬─────────────╮  ╭─────────────┬─────────────┬─────────────┬─────────────┬─────────────╮ ╭──────╮
  &bt BT_NXT              _BT_SEL_KEYS_                ___           ___              ___           ___           ___           ___           ___          &bootloader
//├──────┤ ├─────────────┼─────────────┼─────────────┼─────────────┼─────────────┤  ├─────────────┼─────────────┼─────────────┼─────────────┼─────────────┤ ├──────┤
  &bt BT_CLR ___           ___           ___           ___           ___              ___           ___           ___           ___           ___          &sys_reset
//├──────┤ ├─────────────┼─────────────┼─────────────┼─────────────┼─────────────┤  ├─────────────┼─────────────┼─────────────┼─────────────┼─────────────┤ ├──────┤
    XXX      ___           ___           ___           ___           ___              ___           ___           ___           ___           ___             XXX
//╰──────╯ ╰─────────────┼─────────────┴─────────────┼─────────────┼─────────────┤  ├─────────────┼─────────────┼─────────────┴───────────────────────────╯ ╰──────╯
                                         ___           ___           ___              ___           ___           XXX
//                                     ╰─────────────┴─────────────┴─────────────╯  ╰─────────────┴─────────────┴─────────────╯
)

ZMK_LAYER(mouse,
//╭──────╮ ╭─────────────┬─────────────┬─────────────┬─────────────┬─────────────╮  ╭─────────────┬─────────────┬─────────────┬─────────────┬─────────────╮ ╭──────╮
    XXX      ___           ___           ___           ___           ___              ___           &kp PG_UP     U_MS_U         &kp PG_DN    ___             XXX
//├──────┤ ├─────────────┼─────────────┼─────────────┼─────────────┼─────────────┤  ├─────────────┼─────────────┼─────────────┼─────────────┼─────────────┤ ├──────┤
    XXX      ___           ___           ___           ___           ___              U_WH_L        U_MS_L        U_MS_D         U_MS_R       U_WH_R          XXX
//├──────┤ ├─────────────┼─────────────┼─────────────┼─────────────┼─────────────┤  ├─────────────┼─────────────┼─────────────┼─────────────┼─────────────┤ ├──────┤
    XXX      ___           ___           ___           ___           ___              ___           &mkp LCLK     &mkp MCLK      &mkp RCLK    ___             XXX
//╰──────╯ ╰─────────────┼─────────────┴─────────────┼─────────────┼─────────────┤  ├─────────────┼─────────────┼─────────────┴───────────────────────────╯ ╰──────╯
                                         ___           ___           ___              U_WH_U        U_WH_D        XXX
//                                     ╰─────────────┴─────────────┴─────────────╯  ╰─────────────┴─────────────┴─────────────╯
)

ZMK_LAYER(uc,
//╭──────╮ ╭─────────────┬─────────────┬─────────────┬─────────────┬─────────────╮  ╭─────────────┬─────────────┬─────────────┬─────────────┬─────────────╮ ╭──────╮
    XXX      ___           &el_omega     &el_phi       &el_pi        &el_beta         ___           &el_lambda    &el_upsilon   &el_psi       &de_eszett      XXX
//├──────┤ ├─────────────┼─────────────┼─────────────┼─────────────┼─────────────┤  ├─────────────┼─────────────┼─────────────┼─────────────┼─────────────┤ ├──────┤
    XXX      &el_alpha     &el_rho       &el_sigma     &el_tau       &el_gamma        &el_mu        &el_nu        &el_epsilon   &el_iota      &el_omikron     XXX
//├──────┤ ├─────────────┼─────────────┼─────────────┼─────────────┼─────────────┤  ├─────────────┼─────────────┼─────────────┼─────────────┼─────────────┤ ├──────┤
    XXX      &el_zeta      &el_xi        &el_chi       &el_delta     &el_theta        &el_kappa     &el_eta       &de_ae        &de_oe        &de_ue          XXX
//╰──────╯ ╰─────────────┼─────────────┴─────────────┼─────────────┼─────────────┤  ├─────────────┼─────────────┼─────────────┴───────────────────────────╯ ╰──────╯
                                         ___           ___           ___              ___           ___           XXX
//                                     ╰─────────────┴─────────────┴─────────────╯  ╰─────────────┴─────────────┴─────────────╯
)

ZMK_LAYER(sym,
//╭──────╮ ╭─────────────┬─────────────┬─────────────┬─────────────┬─────────────╮  ╭─────────────┬─────────────┬─────────────┬─────────────┬─────────────╮ ╭──────╮
    XXX      ___     &kp LG(Q)     &kp LG(W)     &kp LG(LS(T)) &kp LG(T)     &kp F1             &kp STAR      &kp FSLH      &kp TILDE     &kp GRAVE       XXX
//├──────┤ ├─────────────┼─────────────┼─────────────┼─────────────┼─────────────┤  ├─────────────┼─────────────┼─────────────┼─────────────┼─────────────┤ ├──────┤
    XXX    &hml LCTRL EXCL &hml LALT AT &hml LGUI HASH &hml LSHFT DLLR &kp F2        ___    &hmr RSHFT AMPS &hmr RGUI PIPE  &hmr RALT PLUS &hmr RCTRL MINUS  XXX
//├──────┤ ├─────────────┼─────────────┼─────────────┼─────────────┼─────────────┤  ├─────────────┼─────────────┼─────────────┼─────────────┼─────────────┤ ├──────┤
    XXX      &kp RG(F)     &kp RG(S)     &kp RG(Z)     &kp RG(RS(Z)) &kp F3            ___           &kp CARET     &kp PRCNT     &kp BSLH      &kp FSLH       XXX
//╰──────╯ ╰─────────────┼─────────────┴─────────────┼─────────────┼─────────────┤  ├─────────────┼─────────────┼─────────────┴───────────────────────────╯ ╰──────╯
                                         ___           ___           ___              &kp RETURN    &kp BSPC      XXX
//                                     ╰─────────────┴─────────────┴─────────────╯  ╰─────────────┴─────────────┴─────────────╯
)

/* vim: set ft=c tw=146: */
